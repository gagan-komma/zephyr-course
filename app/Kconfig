## app/Kconfig
```kconfig
config APP_HEARTBEAT_PERIOD_MS
    int "Heartbeat period in ms"
    default 500
    range 100 2000

source "Kconfig.zephyr"
```

## app/boards/our_board/board.yml
```yaml
board:
  name: our_board
  full_name: nordic our board
  vendor: nordic
  socs:
  # Physical nRF52840 SoC on PCA10056
  - name: nrf52840
```

## app/boards/scratch_board/board.yml
```yaml
board:
  name: scratch_board
  full_name: Scratch Board
  vendor: nordic
  socs:
  - name: nrf52840
```
